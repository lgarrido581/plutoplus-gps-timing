// SPDX-License-Identifier: GPL-2.0
/*
 * plutoplus-gps-timing additions for ADRV9009-ZU11EG + ADRV2CRR-FMC.
 * build_dtb.sh appends this to the ADI board .dts you boot (BASE=...), so the
 * result matches the Kuiper folder whose BOOT.BIN/system.dtb you replace.
 */

/ {
	/*
	 * GPS PPS on PMOD0 pmod0_d0 = EMIO GPIO 12 = gpio 90 (MIO 0-77, then
	 * EMIO). The same pin feeds pps_counter in the FPGA.
	 * Binds only with CONFIG_PPS_CLIENT_GPIO, which ADI's adi_zynqmp_defconfig
	 * leaves off; without it this node is inert and system time comes from
	 * som/ppsc.py chrony (the FPGA counter as a chrony SOCK refclock).
	 */
	pps-gps {
		compatible = "pps-gpio";
		gpios = <&gpio 90 GPIO_ACTIVE_HIGH>;
	};
};

&fpga_axi {
	/*
	 * Registers of the GPS pps_counter (HDL 0x7C460000, remapped by ADI's
	 * ZynqMP interconnect). Software maps it through /dev/mem; the node
	 * records the address and lets uio_pdrv_genirq bind if it is loaded with
	 * of_id=generic-uio.
	 */
	pps_counter: pps-counter@9c460000 {
		compatible = "generic-uio";
		reg = <0x0 0x9c460000 0x1000>;
	};
};
